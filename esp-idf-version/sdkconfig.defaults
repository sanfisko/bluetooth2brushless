## esp-idf-version/sdkconfig.defaults
```kconfig
# Bluetooth конфигурация
CONFIG_BT_ENABLED=y
CONFIG_BT_CLASSIC_ENABLED=y
CONFIG_BT_HID_HOST_ENABLED=y
CONFIG_BT_CONTROLLER_ENABLED=y
CONFIG_BT_BLUEDROID_ENABLED=y

# Отключить BLE для экономии памяти
CONFIG_BT_BLE_ENABLED=n

# Настройки памяти
CONFIG_BT_ALLOCATION_FROM_SPIRAM_FIRST=y
CONFIG_BT_BLE_DYNAMIC_ENV_MEMORY=y

# Логирование
CONFIG_LOG_DEFAULT_LEVEL_INFO=y
CONFIG_LOG_DEFAULT_LEVEL=3

# Настройки GPIO
CONFIG_GPIO_ESP32_SUPPORT_SWITCH_SLP_PULL=y

# Настройки LEDC
CONFIG_LEDC_USE_XTAL_CLK=y
```
